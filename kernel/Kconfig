## kernel/Kconfig
```kconfig
menu "Logging"

config PRINT_INFO
	bool "Verbose information logs"
	default n

config PRINT_STATUS
	bool "Verbose status logs"
	default n

endmenu # Logging

menu "Drivers"

menu "PS2 Keyboard"

config PS2K_INITIAL_BUF_SIZE
    int "Initial buffer size"
    default 16384

config PS2K_DEBUG
    bool "Debugging"
    default n

config PS2K_ALLOC_BUF_MALLOC
    bool "Use malloc over valloc"
    default n

config PS2K_ALLOC_BUF
    bool "Allocate buffer"
    default y

config PS2K_DROP_EVENTS_ON_FAILURE_OR_OVERFLOW
    bool "Drop events on failiure"
    default n

endmenu # PS2 Keyboard

menu "PS2 Mouse"

config DEBUG_MOUSE
	bool "Debugging"
	default n

endmenu # PS2 Mouse

menu "ACPI"

config ACPI_VERBOSE
    bool "Verbose Logging"
    default n

endmenu # ACPI

menu "PCI"

config PCI_VERBOSE
    bool "Verbose Logging"
    default n

endmenu # PCI

menu "Timers"

menu "PIT - Deprecated (Unused)"

config PIT_FREQUENCY
	int "PIT Timer Frequency"
	default 25

endmenu # PIT

menu "APIC Timer"

config FALLBACK_TO_PIT
	bool "Fallback to PIT if APIC not available"
	default y

config APIC_INACCURACY_PROT
	bool "APIC inaccuracy protection"
	default n
	help
		Enabled: improves accuracy of the APIC timer
		Disabled: improves boot time, by a couple of milliseconds
		The higher the more accurate the timer is, can range from 1 millisecond to 10 seconds

config APIC_INACCURACY_PROT_DELAY
	int "Delay in milliseconds" if APIC_INACCURACY_PROT
	range 40 400 if APIC_INACCURACY_PROT # 40 millisecond to 400 milliseconds, the higher to more accurate, i think if TK is a real-time OS then higher is better
	default 40 if APIC_INACCURACY_PROT

endmenu # APIC Timer

endmenu # Timers

menu "Disk Generic Driver"

config DISK_GENERIC_VERBOSE
	bool "Disk Generic verbose output"
	default n

menu "AHCI"

config AHCI_VERBOSE
	bool "AHCI verbose output"
	default n

endmenu # AHCI

menu "NVMe"

config NVME_VERBOSE
	bool "NVMe verbose output"
	default n

endmenu # NVMe

endmenu # Disk Generic driver

menu "Filesystems"

menu "Partitons"

config CONFIG_PARTITONS_VERBOSE
	bool "Partitions verbose output"
	default n

endmenu

menu "FAT32"

config FAT_VERBOSE
	bool "FAT32 verbose output"
	default n

config DUMP_BOOT_SECTOR_ON_FAILURE_SIG
	bool "Dump the boot sector on signature errors"
	default n

endmenu # FAT32

endmenu # Filesystems

endmenu # Drivers

menu "IDT"

menu "Exceptions"

config EXCEPTIONS_NESTING_THRESHOLD
	int "Exceptions nesting threshold"
	default 3

config EXCEPTIONS_RUN_DEBUGGER
	bool "Run the debugger when an exception occurs"
	default n

menu "Default menu"

config EXCEPTION_SHOW_DEFAULT_MENU
	bool "Show the default menu"
	default n

config EXCEPTION_DEFAULT
	int "Default menu" if EXCEPTION_SHOW_DEFAULT_MENU
	default 1 if EXCEPTION_SHOW_DEFAULT_MENU
	range 0 5 if EXCEPTION_SHOW_DEFAULT_MENU
	help
		0: DISASM ONLY
		1: EXCEPTION ONLY
		2: MEMVIEW ONLY
		3: DISASM + EXCEPTION
		4: MEMVIEW + EXCEPTION
		5: STACKTRACE

endmenu # Default menu

config EXCEPTION_DEBUGGER_SYNTAX
	bool "Use Intel Syntax"
	default y
	help
		Intel syntax V. AT&T Syntax... Who wins? Intel ofc :>

config DISASM_STOP_AT_RET
	bool "Make the disassembler stop at any kind of return"
	default n
	help
		If enabled the disassembler will stop showing more disassembly and will stop at the ret instruction
		This includes all of the following instructions:
		- RET
		- IRET
		- IRETQ
		- SYSRET
		- SYSRETQ

endmenu # Exceptions

endmenu # IDT

menu "Syscalls"

config ALLOW_SYSCALL_REGISTRATION_OVERRIDE
    bool "Allow syscall registration override"
    default y
    help
      Allow a system call to be registered even if its syscall
      number (vector) is already in use

      This permits runtime replacement of syscall handlers for some reason

config VERBOSE_SYSCALL_CREATION
	bool "Verbose Logging"
	default n

config ENABLE_SYSCALL_DEBUGGING
	bool "Enable syscall debugging"
	default n

endmenu # Syscalls

menu "APIC"

config APIC_VERBOSE
	bool "Verbose Logging"
	default n

endmenu # APIC

menu "Kernel Messages"

config ENABLE_KERNEL_MESSAGES
	bool "Enable kernel messages"
	default y

endmenu # Kernel Messages

menu "MISC"

menu "Stack Manager"

config DEBUG_STACK_MGR
	bool "Debug stack manager"
	default n

endmenu # Stack Manager

menu "Boot Resources"

menu "BGRT"

config BGRT_SLEEP_TIME_MS
	int "BGRT display time milliseconds"
	default 3000
	range 1000 10000

endmenu # BGRT

endmenu # Boot Resources

config DEV_MODE
	bool "Enable DEV Mode"
	default n
	help
		If enabled disables wait-time processes such as BGRT_SLEEP_TIME_MS ("BGRT display time milliseconds")

endmenu # MISC
```
